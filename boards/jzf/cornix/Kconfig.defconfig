## boards/jzf/cornix/Kconfig.defconfig
```kconfig
# cornix board configuration

# Copyright (c) 2020 The ZMK Contributors
# SPDX-License-Identifier: MIT

## Main device (left side)
if BOARD_CORNIX_LEFT

config ZMK_KEYBOARD_NAME
	default "Cornix"

if USB

config USB_NRFX
    default y

config USB_DEVICE_STACK
    default y

endif # USB
config ZMK_SPLIT_ROLE_CENTRAL
    default y

config ZMK_SPLIT_BLE_ROLE_CENTRAL
	default y

config ZMK_SPLIT_BLE_CENTRAL_BATTERY_LEVEL_FETCHING
	default y

config ZMK_SPLIT_BLE_CENTRAL_BATTERY_LEVEL_PROXY
	default y

endif # BOARD_CORNIX_LEFT

## Peripheral device (right side)
if BOARD_CORNIX_RIGHT || BOARD_CORNIX_PH_LEFT

config ZMK_SPLIT_ROLE_CENTRAL
    default n

config ZMK_SPLIT_BLE_ROLE_CENTRAL
	default n

endif # BOARD_CORNIX_RIGHT

# Common options for both sides
if BOARD_CORNIX_LEFT  || BOARD_CORNIX_PH_LEFT || BOARD_CORNIX_RIGHT


#config BT_CTLR
#    default BT

# Keyboard debouncing — pinned to ZMK default (5ms) on both halves.
# Previously the peripheral was at 3ms which let switch chatter through.
# Bump higher (8–12ms) if chatter returns.
config ZMK_KSCAN_DEBOUNCE_PRESS_MS
    default 5
config ZMK_KSCAN_DEBOUNCE_RELEASE_MS
    default 5

config BOARD_CORNIX_CHARGER
    default y

config ZMK_SPLIT
	default y

config ZMK_BLE
	default y

## disable rgb by default
config ZMK_RGB_UNDERGLOW
	default n
config ZMK_RGB_UNDERGLOW_EXT_POWER
	default n
    

endif # BOARD_CORNIX_LEFT || BOARD_CORNIX_RIGHT
# vim: set ft=kconfig:
```
